;
; LAB13.asm
;
; Created: 14/05/2018 11:52:45
; Author : Camila Barbosa
;

.INCLUDE "m328Pdef.inc"

;.ORG   0x0000                  // Tells the next instruction to be written
;RJMP   SETUP                    // State that the program begins at the main label

SETUP:
;;; ENTRADAS E SAÍDAS - DEFINES
LDI R16, 0x1F               
OUT DDRB, R16               

LDI R16, 0x00
OUT DDRC, R16

LDI R16, 0b11111100
OUT DDRD, R16

;;;; ADMUX CONFIGURACAO
LDI R16, 0b01100000
STS ADMUX, R16

LDI R16, 0b10000111
STS ADCSRA, R16 ;seta ADEN e ADSC p 1

/*;; TCCRnn CONFIGURACAO
LDI R16, 0b10100001
STS TCCR1A, R16

LDI R16, 0b00001001
STS TCCR1B, R16

LDI R16, 0xEF
STS OCR1AL, R16

LDI R16, 0x00
STS OCR1AH, R16*/

LOOP_LEITURA:
LDI R16, 0b11000111
STS ADCSRA, R16 ;seta ADEN e ADSC p 1

ESPERA:
LDS R16, ADCSRA
SBRS R16, 4 ; ver se ADIF é 1
RJMP ESPERA

LDS R16, ADCH // copia o valor analogico para o reg21
//LDS R17, ADCL // copia o valor analogico para o reg22

COMPARA: // 51 102 153 204 255
CPI R16, 51
BRLO APAGA0
SBI PORTD, 2
CPI R16, 102
BRLO APAGA1
SBI PORTD, 3
CPI R16, 153
BRLO APAGA2
SBI PORTD, 4
CPI R16, 204
BRLO APAGA3
SBI PORTD, 5
CPI R16, 255
BRLO APAGA4
SBI PORTD, 7

APAGA0:
CBI PORTD, 2
CBI PORTD, 3
CBI PORTD, 4
CBI PORTD, 5
CBI PORTD, 7
RJMP LOOP_LEITURA
APAGA1:
CBI PORTD, 3
CBI PORTD, 4
CBI PORTD, 5
CBI PORTD, 7
RJMP LOOP_LEITURA
APAGA2:
CBI PORTD, 4
CBI PORTD, 5
CBI PORTD, 7
RJMP LOOP_LEITURA
APAGA3:
CBI PORTD, 5
CBI PORTD, 7
RJMP LOOP_LEITURA
APAGA4:
CBI PORTD, 7

;OUT PORTD, R16

RJMP LOOP_LEITURA

/*STS OCR1AH, R17
STS OCR1AL, R16*/

//RJMP LOOP_LEITURA