;
; Q01.asm
;
; Created: 15/05/2018 15:29:25
; Author : Camila Barbosa
;

.INCLUDE "m328Pdef.inc"

;.EQU timeB= 0b00000101  ; prescaler equal 1024 
;.EQU timeA= 0b00000010  ; mode CTC compare with OCOA
.EQU maxi = 0b11111111  

.ORG   0x0000                          

SETUP:
LDI R16, 0b00011111              
OUT DDRD, R16
LDI R16, 0b11111111
OUT DDRB, R16
; 124

LDI R24, 0x00
LDI R16, 0x00

LDI R27, 0x08
LDI R28, 0x02
LDI R29, 0x01

LDI R30, 0x00 // UP
LDI R31, 0x00 // DOWN

;LDI R29, 0x00
LOOP:
IN R16, PIND
SBRC R16, 7
RJMP UP
IN R16, PIND
SBRC R16, 6
RJMP DOWN
;RJMP LOOP
LDI R30, 0x00 // UP
LDI R31, 0x00 // DOWN
RJMP EXIBIR
;IN R16, PINB
;CPI R16, 0b00000001
;BREQ VPP

BTS:
RJMP EXIBIR

UP:
CPI R30, 0x00
BRNE BTS
LDI R30, 0x01
INC R27
CPI R27, 10
BREQ CARRY0UP
CPI R27, 6
BRNE EXIBIR
CPI R28, 5
BRNE EXIBIR
CPI R29, 2
BRNE EXIBIR
LDI R27, 0
LDI R28, 0
LDI R29, 0
RJMP EXIBIR

CARRY0UP:
LDI R27, 0x00
INC R28
CPI R28, 10
BREQ CARRY1UP
RJMP EXIBIR

CARRY1UP:
LDI R27, 0x00
LDI R28, 0x00
INC R29
RJMP EXIBIR

DOWN:
CPI R31, 0x00
BRNE BTS
LDI R31, 0x01
DEC R27
CPI R27, 255
BREQ CARRY0DOWN
RJMP EXIBIR

CARRY0DOWN:
LDI R27, 9
DEC R28
CPI R28, 255
BREQ CARRY1DOWN
RJMP EXIBIR

CARRY1DOWN:
LDI R27, 9
LDI R28, 9
DEC R29
CPI R29, 255
BRNE EXIBIR
LDI R27, 0x00
LDI R28, 0x00
LDI R29, 0x00

EXIBIR:
MOV R24, R29 ;;;;;;;;;;;;;;;;;;;;; R27
OUT PORTB, R24
SBI PORTD, 2
LDI R25, 20
CALL DELAY
CBI PORTD, 2
MOV R24, R28 ;;;;;;;;;;;;;;;;;;;;; R28
SBI PORTD, 3
OUT PORTB, R24
LDI R25, 20
CALL DELAY
CBI PORTD, 3
MOV R24, R27 ;;;;;;;;;;;;;;;;;;;;; R29
SBI PORTD, 4
OUT PORTB, R24
LDI R25, 20
CALL DELAY
CBI PORTD, 4
;RJMP EXIBIR

RJMP LOOP

DELAY:
LDI R16, 1

OUTER_LOOP:
LDI R24, 0x10;LOW(RAMEND)
LDI R25, 0xF0;LOW(RAMEND)

DELAY_LOOP:
ADIW R24, 1
BRNE DELAY_LOOP
DEC R16
BRNE OUTER_LOOP
RET